/*
 * ILI9341 LCD Display Driver
 */

#include "lcd.h"
#include "board_config.h"
#include "driver/gpio.h"
#include "freertos/FreeRTOS.h"
#include "freertos/task.h"
#include "esp_log.h"

#include "driver/ledc.h"

static const char *TAG = "LCD";

// ILI9341 Commands
#define ILI9341_SWRESET     0x01
#define ILI9341_SLPOUT      0x11
#define ILI9341_DISPON      0x29
#define ILI9341_CASET       0x2A
#define ILI9341_PASET       0x2B
#define ILI9341_RAMWR       0x2C
#define ILI9341_MADCTL      0x36
#define ILI9341_PIXFMT      0x3A

static spi_device_handle_t lcd_spi = NULL;

// Backlight PWM config
#define LCD_BL_LEDC_TIMER      LEDC_TIMER_1
#define LCD_BL_LEDC_MODE       LEDC_LOW_SPEED_MODE
#define LCD_BL_LEDC_CHANNEL    LEDC_CHANNEL_1
#define LCD_BL_LEDC_FREQ_HZ    5000
#define LCD_BL_LEDC_RES        LEDC_TIMER_8_BIT

static bool backlight_pwm_initialized = false;

void lcd_set_backlight(uint8_t brightness) {
    // brightness: 0 (off) to 255 (full)
    if (!backlight_pwm_initialized) return;
    ledc_set_duty(LCD_BL_LEDC_MODE, LCD_BL_LEDC_CHANNEL, brightness);
    ledc_update_duty(LCD_BL_LEDC_MODE, LCD_BL_LEDC_CHANNEL);
}

// Simple 8x8 font
static const uint8_t font8x8[][8] = {
    {0x00,0x00,0x00,0x00,0x00,0x00,0x00,0x00}, // Space
    {0x18,0x3C,0x3C,0x18,0x18,0x00,0x18,0x00}, // !
    {0x36,0x36,0x00,0x00,0x00,0x00,0x00,0x00}, // "
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    {0x7F,0x63,0x31,0x18,0x4C,0x66,0x7F,0x00}, // Z
};

static void lcd_cmd(uint8_t cmd) {
    spi_transaction_t t = {
        .length = 8,
        .tx_buffer = &cmd,
    };
    gpio_set_level(PIN_LCD_DC, 0);
    spi_device_transmit(lcd_spi, &t);
}

static void lcd_data(const uint8_t *data, size_t len) {
    if (len == 0) return;
    spi_transaction_t t = {
        .length = len * 8,
        .tx_buffer = data,
    };
    gpio_set_level(PIN_LCD_DC, 1);
    spi_device_transmit(lcd_spi, &t);
}

static void lcd_data_byte(uint8_t data) {
    lcd_data(&data, 1);
}

static void lcd_set_window(uint16_t x0, uint16_t y0, uint16_t x1, uint16_t y1) {
    uint8_t data[4];
    
    lcd_cmd(ILI9341_CASET);
    data[0] = x0 >> 8; data[1] = x0 & 0xFF;
    data[2] = x1 >> 8; data[3] = x1 & 0xFF;
    lcd_data(data, 4);
    
    lcd_cmd(ILI9341_PASET);
    data[0] = y0 >> 8; data[1] = y0 & 0xFF;
    data[2] = y1 >> 8; data[3] = y1 & 0xFF;
    lcd_data(data, 4);
    
    lcd_cmd(ILI9341_RAMWR);
}

void lcd_fill_rect(uint16_t x, uint16_t y, uint16_t w, uint16_t h, uint16_t color) {
    lcd_set_window(x, y, x + w - 1, y + h - 1);
    
    uint8_t color_hi = color >> 8;
    uint8_t color_lo = color & 0xFF;
    uint8_t line_buf[LCD_WIDTH * 2];
    
    for (int i = 0; i < w; i++) {
        line_buf[i * 2] = color_hi;
        line_buf[i * 2 + 1] = color_lo;
    }
    
    gpio_set_level(PIN_LCD_DC, 1);
    for (int row = 0; row < h; row++) {
        spi_transaction_t t = {
            .length = w * 16,
            .tx_buffer = line_buf,
        };
        spi_device_transmit(lcd_spi, &t);
    }
}

void lcd_fill_screen(uint16_t color) {
    lcd_fill_rect(0, 0, LCD_WIDTH, LCD_HEIGHT, color);
}

void lcd_draw_char(uint16_t x, uint16_t y, char c, uint16_t fg, uint16_t bg) {
    int idx = 0;
    if (c >= ' ' && c <= 'Z') {
        idx = c - ' ';
    }
    
    lcd_set_window(x, y, x + 7, y + 7);
    uint8_t buf[128];
    int bi = 0;
    
    for (int row = 0; row < 8; row++) {
        uint8_t line = font8x8[idx][row];
        for (int col = 0; col < 8; col++) {
            uint16_t color = (line & (1 << col)) ? fg : bg;
            buf[bi++] = color >> 8;
            buf[bi++] = color & 0xFF;
        }
    }
    
    gpio_set_level(PIN_LCD_DC, 1);
    spi_transaction_t t = {
        .length = 128 * 8,
        .tx_buffer = buf,
    };
    spi_device_transmit(lcd_spi, &t);
}

void lcd_draw_string(uint16_t x, uint16_t y, const char *str, uint16_t fg, uint16_t bg) {
    while (*str) {
        lcd_draw_char(x, y, *str, fg, bg);
        x += 8;
        str++;
    }
}

void lcd_init(spi_device_handle_t spi_handle) {
    lcd_spi = spi_handle;
    
    // Configure control pins
    gpio_config_t io_conf = {
        .pin_bit_mask = (1ULL << PIN_LCD_DC) | (1ULL << PIN_LCD_RST) | (1ULL << PIN_LCD_BL),
        .mode = GPIO_MODE_OUTPUT,
    };
    gpio_config(&io_conf);

    // --- Backlight PWM (LEDC) ---
    ledc_timer_config_t ledc_timer = {
        .speed_mode = LCD_BL_LEDC_MODE,
        .timer_num = LCD_BL_LEDC_TIMER,
        .duty_resolution = LCD_BL_LEDC_RES,
        .freq_hz = LCD_BL_LEDC_FREQ_HZ,
        .clk_cfg = LEDC_AUTO_CLK,
    };
    if (ledc_timer_config(&ledc_timer) == ESP_OK) {
        ledc_channel_config_t ledc_channel = {
            .gpio_num = PIN_LCD_BL,
            .speed_mode = LCD_BL_LEDC_MODE,
            .channel = LCD_BL_LEDC_CHANNEL,
            .timer_sel = LCD_BL_LEDC_TIMER,
            .duty = 255, // full brightness by default
            .hpoint = 0,
            .flags.output_invert = 0,
        };
        if (ledc_channel_config(&ledc_channel) == ESP_OK) {
            backlight_pwm_initialized = true;
        }
    }
    if (!backlight_pwm_initialized) {
        // fallback: just turn on
        gpio_set_level(PIN_LCD_BL, 1);
    }
    
    // Hardware reset
    gpio_set_level(PIN_LCD_RST, 0);
    vTaskDelay(pdMS_TO_TICKS(100));
    gpio_set_level(PIN_LCD_RST, 1);
    vTaskDelay(pdMS_TO_TICKS(100));
    
    lcd_cmd(ILI9341_SWRESET);
    vTaskDelay(pdMS_TO_TICKS(150));
    
    lcd_cmd(ILI9341_SLPOUT);
    vTaskDelay(pdMS_TO_TICKS(150));
    
    lcd_cmd(ILI9341_PIXFMT);
    lcd_data_byte(0x55);
    
    lcd_cmd(ILI9341_MADCTL);
    lcd_data_byte(0xE8);
    
    lcd_cmd(ILI9341_DISPON);
    vTaskDelay(pdMS_TO_TICKS(100));
    
    ESP_LOGI(TAG, "ILI9341 LCD initialized");
}

