#include "display.h"
#include "board_config.h"
#include "mcp23017.h"

#include <stdarg.h>
#include <stdio.h>
#include <string.h>
#include "freertos/FreeRTOS.h"
#include "freertos/task.h"
#include "driver/gpio.h"
#include "driver/spi_master.h"
#include "esp_check.h"
#include "esp_heap_caps.h"

static const char *TAG = "display";

static spi_device_handle_t g_disp_spi;

/* =========================================================================
 * 8×8 bitmap font – public domain, printable ASCII 0x20-0x7E
 * ========================================================================= */
static const uint8_t g_font[95][8] = {
    {0x00,0x00,0x00,0x00,0x00,0x00,0x00,0x00}, // ' '
    {0x18,0x18,0x18,0x18,0x00,0x00,0x18,0x00}, // '!'
    {0x66,0x66,0x24,0x00,0x00,0x00,0x00,0x00}, // '"'
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    {0x6E,0x3B,0x00,0x00,0x00,0x00,0x00,0x00}, // '~'
};

static void IRAM_ATTR disp_pre_cb(spi_transaction_t *t)
{
    gpio_set_level(PIN_DISP_DC, (int)(uintptr_t)t->user);
}
static void disp_cmd(uint8_t cmd) {
    spi_transaction_t t={.length=8,.tx_buffer=&cmd,.user=(void*)0};
    spi_device_polling_transmit(g_disp_spi,&t);
}
static void disp_data(const uint8_t *d,size_t len) {
    if(!len) return;
    spi_transaction_t t={.length=len*8,.tx_buffer=d,.user=(void*)1};
    spi_device_polling_transmit(g_disp_spi,&t);
}
static void disp_win(uint16_t x1,uint16_t y1,uint16_t x2,uint16_t y2) {
    uint8_t d[4];
    disp_cmd(0x2A); d[0]=x1>>8;d[1]=x1;d[2]=x2>>8;d[3]=x2; disp_data(d,4);
    disp_cmd(0x2B); d[0]=y1>>8;d[1]=y1;d[2]=y2>>8;d[3]=y2; disp_data(d,4);
    disp_cmd(0x2C);
}
void disp_fill(uint16_t x,uint16_t y,uint16_t w,uint16_t h,uint16_t c) {
    if(!w||!h) return;
    disp_win(x,y,x+w-1,y+h-1);
    const size_t CHUNK=1024;
    uint16_t *buf=heap_caps_malloc(CHUNK*2,MALLOC_CAP_DMA);
    if(!buf) return;
    uint16_t be=(c>>8)|(c<<8);
    for(size_t i=0;i<CHUNK;i++) buf[i]=be;
    size_t tot=(size_t)w*h;
    while(tot){size_t n=tot<CHUNK?tot:CHUNK;
        spi_transaction_t t={.length=n*16,.tx_buffer=buf,.user=(void*)1};
        spi_device_polling_transmit(g_disp_spi,&t); tot-=n;}
    heap_caps_free(buf);
}

/* Render a text string as one DMA transfer: each call is ~1 SPI transaction */
void disp_text(uint16_t x, uint16_t y, const char *s,
                      uint16_t fg, uint16_t bg, uint8_t sc)
{
    int len = (int)strnlen(s, 32);
    if (!len) return;
    int w = len * 8 * sc, h = 8 * sc;
    if (x + w > SCR_W) { w = SCR_W - x; len = w / (8*sc); }
    if (!len || !w || !h) return;
    uint16_t *buf = heap_caps_malloc((size_t)w * h * 2, MALLOC_CAP_DMA);
    if (!buf) return;
    uint16_t fgb = (fg>>8)|(fg<<8);
    uint16_t bgb = (bg>>8)|(bg<<8);
    for (int ci=0; ci<len; ci++) {
        char c = s[ci];
        if (c<0x20||c>0x7E) c=' ';
        const uint8_t *g = g_font[(uint8_t)(c-0x20)];
        for (int row=0; row<8; row++) for (int sr=0; sr<sc; sr++)
            for (int col=0; col<8; col++) {
                uint16_t px = (g[row]>>col)&1 ? fgb : bgb;
                for (int sc2=0; sc2<sc; sc2++)
                    buf[(row*sc+sr)*w + ci*8*sc + col*sc+sc2] = px;
            }
    }
    disp_win(x, y, x+w-1, y+h-1);
    spi_transaction_t t={.length=(size_t)w*h*16,.tx_buffer=buf,.user=(void*)1};
    spi_device_polling_transmit(g_disp_spi, &t);
    heap_caps_free(buf);
}

esp_err_t display_bus_init(void)
{
    const spi_bus_config_t bus={
        .mosi_io_num=PIN_DISP_MOSI,.miso_io_num=PIN_DISP_MISO,
        .sclk_io_num=PIN_DISP_SCLK,.quadwp_io_num=-1,.quadhd_io_num=-1,.max_transfer_sz=65536};
    ESP_RETURN_ON_ERROR(spi_bus_initialize(SPI_B_HOST,&bus,SPI_DMA_CH_AUTO),TAG,"spb");
    const spi_device_interface_config_t dd={.clock_speed_hz=40*1000*1000,.mode=0,
        .spics_io_num=PIN_DISP_CS,.queue_size=8,.pre_cb=disp_pre_cb};
    return spi_bus_add_device(SPI_B_HOST,&dd,&g_disp_spi);
}

void ili9341_init(void)
{
    uint8_t olat=0; mcp_read(MCP_OLATA,&olat);
    mcp_write(MCP_OLATA, olat&~GPA_DISP_RST); vTaskDelay(pdMS_TO_TICKS(20));
    mcp_write(MCP_OLATA, olat|GPA_DISP_RST);  vTaskDelay(pdMS_TO_TICKS(150));
    disp_cmd(0x01); vTaskDelay(pdMS_TO_TICKS(150));
    disp_cmd(0x11); vTaskDelay(pdMS_TO_TICKS(120));
    disp_cmd(0x3A); disp_data((uint8_t[]){0x55},1);
    disp_cmd(0x36); disp_data((uint8_t[]){0x48},1);
    disp_cmd(0x29); vTaskDelay(pdMS_TO_TICKS(20));
    gpio_set_level(PIN_DISP_LED,1);
}

/* Printf-style row draw in the detail content area */
void drow(int row, uint16_t fg, uint16_t bg, const char *fmt, ...)
{
    char buf[32];
    va_list ap; va_start(ap,fmt); vsnprintf(buf,sizeof(buf),fmt,ap); va_end(ap);
    uint16_t y = DCONTENT_Y + row * DROW_H;
    disp_fill(0, y, SCR_W, DROW_H, bg);
    disp_text(DPAD, y+3, buf, fg, bg, 1);
}

/* Horizontal progress bar (fraction 0.0-1.0) */
void draw_bar(uint16_t x, uint16_t y, uint16_t w, uint16_t h,
              float frac, uint16_t fill, uint16_t empty)
{
    if (frac < 0.0f) frac = 0.0f;
    if (frac > 1.0f) frac = 1.0f;
    uint16_t fw = (uint16_t)(frac * w);
    if (fw) disp_fill(x, y, fw,   h, fill);
    if (fw < w) disp_fill(x+fw, y, w-fw, h, empty);
}

/* Full-width touch button spanning `rows_h` detail rows */
void detail_btn(int row, int rows_h, const char *label, uint16_t bg)
{
    uint16_t y = DCONTENT_Y + row * DROW_H;
    uint16_t h = (uint16_t)(rows_h * DROW_H);
    disp_fill(0, y, SCR_W, h, bg);
    int len = (int)strlen(label);
    int tx = (SCR_W - len * 8) / 2;
    if (tx < DPAD) tx = DPAD;
    disp_text(tx, y + (h-8)/2, label, C_WHITE, bg, 1);
}

/* Detail view header with back arrow */
void detail_header(const char *title)
{
    disp_fill(0, 0, SCR_W, HDR_H, C_NAVY);
    char buf[24]; snprintf(buf, sizeof(buf), "< %s", title);
    disp_text(DPAD, (HDR_H-16)/2, buf, C_WHITE, C_NAVY, 2);
}
